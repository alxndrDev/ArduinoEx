int col[8] = {A1, 7, 6, A4, 4, A3, 12, 13};
int row[8] = {A5, A0, 2, A2, 9, 3, 8, 5};


int num = 8;

void setup() {
  for(int i = 0;i<num;i++){
    pinMode(col[i], OUTPUT);
    pinMode(row[i], OUTPUT);
  }
  Serial.begin(9600);

}

 byte row_arr[8][8] = {
      {0,1,1,1,1,1,1,1},
      {1,0,1,1,1,1,1,1},
      {1,1,0,1,1,1,1,1},
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      {1,1,1,1,1,1,1,0}};

  byte pattern[8][8]={
    {1,1,0,0,1,1,0,0},
    {1,1,0,0,1,1,0,0},
    {0,0,1,1,0,0,1,1},
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    {0,0,1,1,0,0,1,1} };
// Z
  byte pattern1[8][8]={
     {1,1,1,1,1,1,1,1},
    {0,0,0,0,0,1,1,0},
    {0,0,0,0,1,1,0,0},
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    {1,1,1,1,1,1,1,1}
  };
// HEART
  byte heart[8][8] = {
    {0,0,0,0,0,0,0,0},
    {0,1,1,0,0,1,1,0},
    {1,1,1,1,1,1,1,1},
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    {0,0,0,0,0,0,0,0}
  };

byte alpabet[36][8] = {
    {0x7c, 0xc6, 0xce, 0xde, 0xf6, 0xe6, 0x7c, 0x00},  // 0030 (zero)
    {0x30, 0x70, 0x30, 0x30, 0x30, 0x30, 0xfc, 0x00},  // 0031 (one)
    {0x78, 0xcc, 0x0c, 0x38, 0x60, 0xc4, 0xfc, 0x00},  // 0032 (two)
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    { 0x7F, 0x63, 0x31, 0x18, 0x4C, 0x66, 0x7F, 0x00},   // U+005A (Z)
    
};



//numbers
byte number[10][8] = {
    {0x7c, 0xc6, 0xce, 0xde, 0xf6, 0xe6, 0x7c, 0x00},  // 0030 (zero)
    {0x30, 0x70, 0x30, 0x30, 0x30, 0x30, 0xfc, 0x00},  // 0031 (one)
    {0x78, 0xcc, 0x0c, 0x38, 0x60, 0xc4, 0xfc, 0x00},  // 0032 (two)
    {0x78, 0xcc, 0x0c, 0x38, 0x0c, 0xcc, 0x78, 0x00},  // 0033 (three)
    {0x1c, 0x3c, 0x6c, 0xcc, 0xfe, 0x0c, 0x1e, 0x00},  // 0034 (four)
    {0xfc, 0xc0, 0xf8, 0x0c, 0x0c, 0xcc, 0x78, 0x00},  // 0035 (five)
    {0x38, 0x60, 0xc0, 0xf8, 0xcc, 0xcc, 0x78, 0x00},  // 0036 (six)
    {0xfc, 0xcc, 0x0c, 0x18, 0x30, 0x30, 0x30, 0x00},  // 0037 (seven)
    {0x78, 0xcc, 0xcc, 0x78, 0xcc, 0xcc, 0x78, 0x00},  // 0038 (eight)
    {0x78, 0xcc, 0xcc, 0x7c, 0x0c, 0x18, 0x70, 0x00}  // 0039 (nine)
};

int rn = 0;
int cn = 0;
int nums = 0;
int flag = 0;

void loop() {
  if(Serial.available()){
    byte val = Serial.read();
    Serial.println(val);
    // 현재 알파벳이 거꾸로 나오는 현상 때문에 조건을 줌.
    if( val >= '0' && val <= '9' ) {
      nums = val - '0';
    }
    else if(  val >= 'A' && val <= 'Z' ) {
      nums = val - 'A' + 10;
    }
  }

  for(int temp =0;temp<8; temp++){
    for(int rowNum = 0; rowNum <8; rowNum++){
      digitalWrite(row[rowNum], !row_arr[rn][rowNum]);
    }
    // row number가 8이면 0으로 초기화
    rn++; //row Number 증가
    if(rn==8){rn = 0;}


    byte tmp;

    if( nums < 10 )  tmp = 0x01;
    else            tmp = 0x80;
    
    for( int j = 8; j > 0; j-- ) {  // byte 처리
      if( tmp & alpabet[nums][cn] )  digitalWrite(col[j], 0);
      else  digitalWrite(col[j], 1);
      
      if( nums < 10 )  tmp <<= 1;
      else            tmp >>= 1;
    }
    cn++;
   
    if(cn ==8)cn=0;
    delayMicroseconds(200);

    for(int colNum=0;colNum<8; colNum++){
      digitalWrite(col[colNum], 1);
    }
  }
}
